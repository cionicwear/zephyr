## boards/arm/cionic_apollo_nrf52820/Kconfig
```kconfig
# Cionic Apollo nRF52820 board configuration

# Copyright (c) 2020 Nordic Semiconductor ASA
# SPDX-License-Identifier: Apache-2.0

config BOARD_ENABLE_DCDC
	bool "Enable DCDC mode"
	select SOC_DCDC_NRF52X
	default y
	depends on BOARD_CIONIC_APOLLO_NRF52820
```

## boards/arm/cionic_apollo_nrf52820/Kconfig.board
```kconfig
# Cionic Apollo nRF52820 board configuration

# Copyright (c) 2020 Nordic Semiconductor ASA
# SPDX-License-Identifier: Apache-2.0

config BOARD_CIONIC_APOLLO_NRF52820
	bool "CIONIC APOLLO NRF52820"
	depends on SOC_NRF52820_QDAA
```

## boards/arm/cionic_apollo_nrf52820/Kconfig.defconfig
```kconfig
# CIONIC APOLLO nRF52820 board configuration

# Copyright (c) 2020 Nordic Semiconductor ASA
# SPDX-License-Identifier: Apache-2.0

if BOARD_CIONIC_APOLLO_NRF52820

config BOARD
	default "cionic_apollo_nrf52820"

config BT_CTLR
	default BT

endif # BOARD_CIONIC_APOLLO_NRF52820
```
